## boards/arm/ra8p1/titan-mini/configs/asrdemo/defconfig
```kconfig
CONFIG_ALLOW_BSD_COMPONENTS=y
CONFIG_HOST_MACOS=y
CONFIG_BASE_DEFCONFIG="titan-mini/asrdemo"
CONFIG_INTELHEX_BINARY=y
CONFIG_ARCH_SETJMP_H=y
CONFIG_DEBUG_FEATURES=y
# CONFIG_DEBUG_INFO is not set
CONFIG_STACK_COLORATION=y
CONFIG_DEBUG_SYMBOLS=y
CONFIG_DEBUG_FULLOPT=y
CONFIG_ARCH="arm"
CONFIG_ARCH_CHIP_RA8P1=y
CONFIG_ARCH_ARMV8M=y
CONFIG_ARCH_FAMILY="armv8-m"
CONFIG_ARCH_CHIP="ra8p1"
CONFIG_ARCH_CHIP_R7KA8P1KF=y
CONFIG_ARMV8M_ICACHE=y
CONFIG_RA_SCI2_UART=y
CONFIG_RA8P1_SDRAM=y
CONFIG_RA8P1_I2C0=y
CONFIG_RA8P1_I2C1=y
CONFIG_RA8P1_I2C_SCHEDLOCK=y
CONFIG_RA8P1_ETHERNET=y
CONFIG_ARCH_PERF_EVENTS=y
CONFIG_ARCH_IRQPRIO=y
CONFIG_ARCH_STACKDUMP=y
CONFIG_BOARD_LOOPSPERMSEC=166667
CONFIG_RAM_START=0x22000000
CONFIG_RAM_SIZE=458752
CONFIG_ARCH_BOARD_TITAN_MINI=y
CONFIG_ARCH_BOARD="titan-mini"
# CONFIG_ARCH_LEDS is not set
CONFIG_TITAN_MINI_USERLEDS=y
CONFIG_TITAN_MINI_BUTTONS=y
CONFIG_TITAN_MINI_OSPI=y
CONFIG_TITAN_MINI_SDHI=y
CONFIG_TITAN_MINI_VOICE_DEMO_AUTOSTART=y
CONFIG_TITAN_MINI_USBFS_CDC=y
CONFIG_TITAN_MINI_AUDIO=y
CONFIG_TITAN_MINI_AUDIO_VOLUME=0x80
CONFIG_TITAN_MINI_ETHOSU55=y
CONFIG_TITAN_MINI_CAMERA=y
CONFIG_TITAN_MINI_PDM=y
CONFIG_TITAN_MINI_PDM_REFERENCE=y
CONFIG_INIT_STACKSIZE=4096
CONFIG_INIT_ENTRYPOINT="nsh_main"
CONFIG_TASK_NAME_SIZE=32
CONFIG_SCHED_WAITPID=y
CONFIG_SCHED_LPWORKSTACKSIZE=4096
CONFIG_IDLETHREAD_STACKSIZE=2048
# CONFIG_MMCSD_MMCSUPPORT is not set
# CONFIG_MMCSD_HAVE_WRITEPROTECT is not set
# CONFIG_MMCSD_SPI is not set
CONFIG_SCI2_SERIAL_CONSOLE=y
CONFIG_USBDEV_MAXPOWER=10
CONFIG_CDCACM_BULKIN_REQLEN=512
CONFIG_CDCACM_DISABLE_TXBUF=y
CONFIG_CDCACM_VENDORID=0x045b
CONFIG_CDCACM_PRODUCTID=0x5310
CONFIG_CDCACM_VENDORSTR="RENESAS"
CONFIG_CDCACM_PRODUCTSTR="CDC USB Demonstration"
CONFIG_SYSLOG_CONSOLE=y
CONFIG_FS_FAT=y
CONFIG_FS_LARGEFILE=y
CONFIG_GPT_PARTITION=y
CONFIG_FSUTILS_MKGPT=y
CONFIG_NSH_CMDOPT_HEXDUMP=y
CONFIG_NET=y
CONFIG_NET_TCP=y
CONFIG_NET_TCP_WRITE_BUFFERS=y
CONFIG_NET_ETH_PKTSIZE=1514
CONFIG_NET_SEND_BUFSIZE=16384
CONFIG_NET_UDP=y
CONFIG_NETUTILS_DHCPC=y
CONFIG_NETINIT_DHCPC=y
CONFIG_NETINIT_THREAD=y
CONFIG_NETINIT_THREAD_STACKSIZE=4096
CONFIG_NETINIT_THREAD_PRIORITY=80
CONFIG_NETINIT_DRIPADDR=0xc0a84d01
CONFIG_NETINIT_NETMASK=0xffffff00
CONFIG_IOB_BUFSIZE=1514
CONFIG_IOB_NBUFFERS=16
CONFIG_IOB_THROTTLE=4
CONFIG_NETUTILS_WEBSERVER=y
CONFIG_NETUTILS_HTTPD_SINGLECONNECT=y
CONFIG_NETUTILS_HTTPD_SENDFILE=y
CONFIG_NETUTILS_HTTPD_DIRLIST=y
CONFIG_NETUTILS_HTTPD_PATH="/sdcard"
CONFIG_NETUTILS_HTTPD_TIMEOUT=10
CONFIG_NETUTILS_HTTPD_SEND_DELAY_US=20000
CONFIG_NET_SOCKOPTS=y
CONFIG_FS_PROCFS=y
CONFIG_FS_TMPFS=y
CONFIG_FS_LITTLEFS_PROGRAM_SIZE_FACTOR=1
CONFIG_FS_LITTLEFS_LOOKAHEAD_SIZE=128
CONFIG_FS_LITTLEFS_BLOCK_CYCLE=-1
CONFIG_FS_LITTLEFS_NAME_MAX=255
CONFIG_MM_REGIONS=2
CONFIG_BUILTIN=y
CONFIG_LIBM=y
CONFIG_HAVE_CXX=y
CONFIG_LIBCXXTOOLCHAIN=y
CONFIG_LIBMINIABI=y
CONFIG_MATH_GEMMLOWP=y
CONFIG_MATH_KISSFFT=y
CONFIG_MATH_RUY=y
CONFIG_TFLITEMICRO=y
CONFIG_TFLITEMICRO_ETHOSU=y
CONFIG_NSH_READLINE=y
CONFIG_NSH_BUILTIN_APPS=y
# CONFIG_NSH_DISABLE_MW is not set
CONFIG_SYSTEM_FLATBUFFERS=y
CONFIG_SYSTEM_I2CTOOL=y
CONFIG_I2CTOOL_MAXBUS=1
CONFIG_SYSTEM_NSH=y
CONFIG_SYSTEM_NXPLAYER=y
CONFIG_NXPLAYER_MAINTHREAD_STACKSIZE=4096
CONFIG_NXPLAYER_PLAYTHREAD_STACKSIZE=4096
CONFIG_SYSTEM_PDMTEST=y
CONFIG_TESTING_TITAN_ASR=y
CONFIG_TESTING_TITAN_DEMO=y
CONFIG_TESTING_TITAN_DEMO_STORAGE=y
CONFIG_TESTING_TITAN_DEMO_DIRECTORY="/sdcard/media"
CONFIG_TESTING_TITAN_DEMO_FRONTEND_MODE=0
CONFIG_TESTING_TITAN_ASR_FP32_MATH=y
CONFIG_TESTING_TITAN_ASR_MVE=y
CONFIG_TESTING_TITAN_ASR_INT8_EXP_CACHE=y
CONFIG_TESTING_TITAN_ASR_OPT=y
CONFIG_TESTING_TITAN_ASR_LM_CACHE=y
CONFIG_TESTING_TITAN_ASR_MIC_RATE=16547
CONFIG_TESTING_TITAN_ASR_MIC_MEAN=y
CONFIG_TESTING_TITAN_ASR_DUPLEX=y
CONFIG_TESTING_TITAN_ASR_REFERENCE_GAIN=8
CONFIG_TESTING_TITAN_ASR_QUEUE_BLOCKS=512
CONFIG_TESTING_TITAN_ASR_END_BLOCKS=35
CONFIG_TESTING_TITAN_ASR_MARKER_END=80
CONFIG_TESTING_TITAN_ASR_VAD_MIN_POWER=40000
CONFIG_TESTING_TITAN_ASR_VAD_CONFIRM=y
CONFIG_TESTING_TITAN_ASR_MIN_CONFIDENCE=65
```

## boards/arm/ra8p1/titan-mini/configs/asrduplex/defconfig
```kconfig
CONFIG_ALLOW_BSD_COMPONENTS=y
CONFIG_HOST_MACOS=y
CONFIG_BASE_DEFCONFIG="titan-mini/asrduplex"
CONFIG_INTELHEX_BINARY=y
CONFIG_ARCH_SETJMP_H=y
CONFIG_DEBUG_FEATURES=y
# CONFIG_DEBUG_INFO is not set
CONFIG_DEBUG_NET=y
CONFIG_DEBUG_NET_ERROR=y
CONFIG_DEBUG_NET_WARN=y
CONFIG_STACK_COLORATION=y
CONFIG_DEBUG_SYMBOLS=y
CONFIG_DEBUG_FULLOPT=y
CONFIG_ARCH_CHIP_RA8P1=y
CONFIG_ARMV8M_ICACHE=y
CONFIG_RA_SCI2_UART=y
CONFIG_RA8P1_SDRAM=y
CONFIG_RA8P1_I2C0=y
CONFIG_RA8P1_I2C1=y
CONFIG_RA8P1_ETHERNET=y
CONFIG_ARCH_PERF_EVENTS=y
CONFIG_ARCH_IRQPRIO=y
CONFIG_ARCH_STACKDUMP=y
CONFIG_BOARD_LOOPSPERMSEC=166667
CONFIG_RAM_START=0x22000000
CONFIG_RAM_SIZE=458752
CONFIG_ARCH_BOARD_TITAN_MINI=y
# CONFIG_ARCH_LEDS is not set
CONFIG_TITAN_MINI_USERLEDS=y
CONFIG_TITAN_MINI_BUTTONS=y
CONFIG_TITAN_MINI_GPIO=y
CONFIG_TITAN_MINI_PWM6=y
CONFIG_TITAN_MINI_PWM7=y
CONFIG_TITAN_MINI_OSPI=y
CONFIG_TITAN_MINI_SDHI=y
CONFIG_TITAN_MINI_SPI1=y
CONFIG_TITAN_MINI_CANFD0=y
CONFIG_TITAN_MINI_USBFS_CDC=y
CONFIG_TITAN_MINI_AUDIO=y
CONFIG_TITAN_MINI_AUDIO_VOLUME=0x80
CONFIG_TITAN_MINI_ADC=y
CONFIG_TITAN_MINI_RTC=y
CONFIG_TITAN_MINI_WDT=y
CONFIG_TITAN_MINI_ETHOSU55=y
CONFIG_TITAN_MINI_CAMERA=y
CONFIG_TITAN_MINI_PDM=y
CONFIG_TITAN_MINI_PDM_REFERENCE=y
CONFIG_TITAN_MINI_IMU=y
CONFIG_INIT_STACKSIZE=4096
CONFIG_INIT_ENTRYPOINT="nsh_main"
CONFIG_TASK_NAME_SIZE=32
CONFIG_SCHED_WAITPID=y
CONFIG_SCHED_LPWORKSTACKSIZE=4096
CONFIG_IDLETHREAD_STACKSIZE=2048
# CONFIG_MMCSD_MMCSUPPORT is not set
# CONFIG_MMCSD_HAVE_WRITEPROTECT is not set
# CONFIG_MMCSD_SPI is not set
CONFIG_SCI2_SERIAL_CONSOLE=y
CONFIG_USBDEV_MAXPOWER=10
CONFIG_CDCACM_BULKIN_REQLEN=512
CONFIG_CDCACM_DISABLE_TXBUF=y
CONFIG_CDCACM_VENDORID=0x045b
CONFIG_CDCACM_PRODUCTID=0x5310
CONFIG_CDCACM_VENDORSTR="RENESAS"
CONFIG_CDCACM_PRODUCTSTR="CDC USB Demonstration"
CONFIG_SYSLOG_CONSOLE=y
CONFIG_NET=y
CONFIG_NET_ETH_PKTSIZE=1514
CONFIG_NET_SEND_BUFSIZE=16384
CONFIG_NET_TCP=y
CONFIG_NET_TCP_WRITE_BUFFERS=y
CONFIG_NET_UDP=y
CONFIG_NET_ICMP_SOCKET=y
CONFIG_NET_STATISTICS=y
CONFIG_FS_FAT=y
CONFIG_FS_PROCFS=y
CONFIG_FS_LITTLEFS_PROGRAM_SIZE_FACTOR=1
CONFIG_FS_LITTLEFS_LOOKAHEAD_SIZE=128
CONFIG_FS_LITTLEFS_BLOCK_CYCLE=-1
CONFIG_FS_LITTLEFS_NAME_MAX=255
CONFIG_MM_REGIONS=2
CONFIG_IOB_NBUFFERS=16
CONFIG_IOB_BUFSIZE=1514
CONFIG_IOB_THROTTLE=4
CONFIG_NETDB_DNSCLIENT=y
CONFIG_BUILTIN=y
CONFIG_LIBM=y
CONFIG_HAVE_CXX=y
CONFIG_LIBCXXTOOLCHAIN=y
CONFIG_LIBMINIABI=y
CONFIG_EXAMPLES_ADC=y
CONFIG_EXAMPLES_ADC_NSAMPLES=5
CONFIG_EXAMPLES_ADC_GROUPSIZE=1
CONFIG_EXAMPLES_ADC_SWTRIG=y
CONFIG_EXAMPLES_BUTTONS=y
CONFIG_EXAMPLES_BUTTONS_NAMES=y
CONFIG_EXAMPLES_BUTTONS_QTD=1
CONFIG_EXAMPLES_BUTTONS_NAME0="USER"
CONFIG_EXAMPLES_CAN=y
CONFIG_EXAMPLES_CAN_NMSGS=4
CONFIG_EXAMPLES_GPIO=y
CONFIG_EXAMPLES_LEDS=y
CONFIG_EXAMPLES_PWM=y
CONFIG_EXAMPLES_WATCHDOG=y
CONFIG_EXAMPLES_WATCHDOG_PINGTIME=3000
CONFIG_EXAMPLES_WATCHDOG_TIMEOUT=2147
CONFIG_MATH_GEMMLOWP=y
CONFIG_MATH_KISSFFT=y
CONFIG_MATH_RUY=y
CONFIG_TFLITEMICRO=y
CONFIG_TFLITEMICRO_ETHOSU=y
CONFIG_NETUTILS_NETCAT=y
CONFIG_NETINIT_THREAD=y
CONFIG_NETINIT_THREAD_STACKSIZE=4096
CONFIG_NETINIT_DHCPC=y
CONFIG_NETINIT_DNS=y
CONFIG_NETINIT_DNSIPADDR=0xc0a84d01
CONFIG_NSH_READLINE=y
CONFIG_NSH_BUILTIN_APPS=y
# CONFIG_NSH_DISABLE_MW is not set
CONFIG_SYSTEM_CAMERATEST=y
CONFIG_SYSTEM_DHCPC_RENEW=y
CONFIG_SYSTEM_FLATBUFFERS=y
CONFIG_SYSTEM_I2CTOOL=y
CONFIG_I2CTOOL_MAXBUS=1
CONFIG_SYSTEM_NSH=y
CONFIG_SYSTEM_NXPLAYER=y
CONFIG_NXPLAYER_MAINTHREAD_STACKSIZE=4096
CONFIG_NXPLAYER_PLAYTHREAD_STACKSIZE=4096
CONFIG_SYSTEM_PDMTEST=y
CONFIG_SYSTEM_PING=y
CONFIG_SYSTEM_SENSORTEST=y
CONFIG_SYSTEM_SPITOOL=y
CONFIG_SPITOOL_MINBUS=1
CONFIG_SPITOOL_MAXBUS=1
CONFIG_SPITOOL_DEFFREQ=1000000
CONFIG_SYSTEM_WEBCAM=y
CONFIG_TESTING_TITAN_ASR=y
CONFIG_TESTING_TITAN_ASR_WINDOW_TEXT_FALLBACK=y
CONFIG_TESTING_TITAN_ASR_FP32_MATH=y
CONFIG_TESTING_TITAN_ASR_MVE=y
CONFIG_TESTING_TITAN_ASR_INT8_EXP_CACHE=y
CONFIG_TESTING_TITAN_ASR_OPT=y
CONFIG_TESTING_TITAN_ASR_LM_CACHE=y
CONFIG_TESTING_TITAN_ASR_MIC_RATE=16547
CONFIG_TESTING_TITAN_ASR_MIC_MEAN=y
CONFIG_TESTING_TITAN_ASR_DUPLEX=y
CONFIG_TESTING_TITAN_ASR_RESIDUAL=y
CONFIG_TESTING_TITAN_ASR_REFERENCE_GAIN=8
CONFIG_TESTING_TITAN_ASR_ECHO_SUPPRESS=-60
CONFIG_TESTING_TITAN_ASR_SNAPSHOT_TRACE=y
CONFIG_TESTING_TITAN_ASR_QUEUE_BLOCKS=512
CONFIG_TESTING_TITAN_ASR_BUFFERED_DUMP=y
CONFIG_TESTING_TITAN_ASR_MARKER_END=35
CONFIG_TESTING_TITAN_ASR_VAD_MIN_POWER=160000
CONFIG_TESTING_TITAN_ASR_VAD_CONFIRM=y
CONFIG_TESTING_TITAN_ASR_PREROLL_ROWS=10
CONFIG_TESTING_TITAN_ASR_MIN_CONFIDENCE=65
CONFIG_TESTING_TITAN_ASR_NEGATIVE_WAKE_VETO=y
CONFIG_TESTING_TITAN_ASR_INLINE_TEXT_CONFIRM=y
CONFIG_TESTING_TITAN_ASR_WINDOW_TEXT_CONFIRM=y
CONFIG_TESTING_TITAN_ASR_POSTROLL_ROWS=3
CONFIG_TESTING_TITAN_ASR_POSTROLL_MIN_MS=1500
CONFIG_TESTING_TITAN_ASR_VAD_START_BLOCKS=20
CONFIG_TESTING_TITAN_ASR_VAD_ONSET_HOLD=10
```

## drivers/aie/Kconfig
```kconfig
#
# For a description of the syntax of this configuration file,
# see the file kconfig-language.txt in the NuttX tools repository.
#

config AI_ENGINE
	bool "AI Engine Acceleration Support"
	default n
	---help---
		Upper-half character driver for hardware AI / NPU engines.
		A board or architecture lower-half must implement struct
		aie_ops_s and call aie_register(). See
		include/nuttx/aie/ai_engine.h.

if AI_ENGINE

config AI_ENGINE_ETHOSU
	bool "Arm Ethos-U core driver"
	default n
	---help---
		Build the upstream Arm Ethos-U core driver for use by an
		architecture-specific NuttX AI engine lower-half.

config AI_ENGINE_ETHOSU_TIMEOUT_MS
	int "Ethos-U inference timeout in milliseconds"
	default 5000
	range 1 60000
	depends on AI_ENGINE_ETHOSU

config AI_ENGINE_ETHOSU_DEBUG
	bool "Ethos-U verbose logging"
	default n
	depends on AI_ENGINE_ETHOSU

endif # AI_ENGINE
```
